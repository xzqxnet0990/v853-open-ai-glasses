## docs/reference/openwrt_packages_legacy/ai-glass-sdk/Config.in
```kconfig
config PACKAGE_ai-glass-sdk
	bool "ai-glass-sdk"
	default y
	select PACKAGE_libpthread
	select PACKAGE_librt
	help
	  AI Glass SDK adapter layer for V853 platform.

	  This package provides hardware abstraction APIs for:
	  - GPIO event monitoring via sysfs
	  - V4L2 camera capture (NV12/JPEG)
	  - ALSA audio playback

	  Version: 2.0.0
	  Platform: Allwinner V853

config AI_GLASS_SDK_EXAMPLES
	bool "Build SDK example programs"
	depends on PACKAGE_ai-glass-sdk
	default n
	help
	  Build example test programs:
	  - camera_test: Test V4L2 camera capture
	  - audio_test: Test ALSA audio playback
	  - gpio_test: Test GPIO event monitoring
```

## docs/reference/openwrt_packages_legacy/display-qt/Config.in
```kconfig
config PACKAGE_ai-glass-display
	bool "ai-glass-display"
	default y
	depends on PACKAGE_ai-glass-sdk
	select PACKAGE_qt5-core
	select PACKAGE_qt5-gui
	select PACKAGE_qt5-widgets
	select PACKAGE_fontconfig
	help
	  Qt5-based display application for AI Glasses.

	  Requirements:
	  - Qt5 (Qt5Base, Qt5Widgets)
	  - AI Glass SDK
	  - MIPI DSI display driver
	  - LinuxFB or EGLFS backend

	  Display: 1280x720@60Hz MIPI DSI
	  Version: 2.0.0

config AI_GLASS_DISPLAY_EGLFS
	bool "Enable EGLFS hardware acceleration"
	depends on PACKAGE_ai-glass-display
	default y
	help
	  Use EGLFS backend for hardware-accelerated rendering.
	  Requires DRM/KMS support.

config AI_GLASS_DISPLAY_AUTO_START
	bool "Auto-start display on boot"
	depends on PACKAGE_ai-glass-display
	default y
	help
	  Automatically start display application at boot via init script.
```

## docs/reference/openwrt_packages_legacy/system-services/Config.in
```kconfig
config PACKAGE_ai-glass-services
	bool "ai-glass-services"
	default y
	depends on PACKAGE_ai-glass-sdk
	select PACKAGE_libpthread
	select PACKAGE_librt
	help
	  AI Glasses system services for V853 platform.

	  Core services:
	  - ai-core: Hardware abstraction service
	  - power_manager: Power monitoring
	  - log_daemon: Log collection

	  Version: 2.0.0

config AI_GLASS_SERVICE_AI_CORE
	bool "Enable ai-core service"
	depends on PACKAGE_ai-glass-services
	default y
	help
	  Core hardware service providing:
	  - GPIO event monitoring and distribution
	  - Camera capture service (V4L2)
	  - Audio playback control (ALSA)

config AI_GLASS_SERVICE_POWER_MANAGER
	bool "Enable power_manager service"
	depends on PACKAGE_ai-glass-services
	default y
	help
	  Power monitoring daemon:
	  - Dual power source monitoring (12V + Battery)
	  - Low battery alerts
	  - Power state management

config AI_GLASS_SERVICE_LOG_DAEMON
	bool "Enable log_daemon service"
	depends on PACKAGE_ai-glass-services
	default y
	help
	  System log collection daemon:
	  - Multi-process log aggregation
	  - Log rotation and cleanup
	  - Remote syslog support
```
